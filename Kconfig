## Kconfig
```kconfig
# Kconfig file for package sht4x
menuconfig PKG_USING_SHT4X
    bool "Please add description of sht4x in English."
    default n

if PKG_USING_SHT4X

    config PKG_SHT4X_PATH
        string
        default "/packages/peripherals/sht4x"

    choice
        prompt "Version"
        default PKG_USING_SHT4X_LATEST_VERSION
        help
            Select the package version

        config PKG_USING_SHT4X_V100
            bool "v1.0.0"

        config PKG_USING_SHT4X_LATEST_VERSION
            bool "latest"
    endchoice

    config PKG_SHT4X_VER
       string
       default "v1.0.0"    if PKG_USING_SHT4X_V100
       default "latest"    if PKG_USING_SHT4X_LATEST_VERSION

endif
```
